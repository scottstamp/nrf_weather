## bridge/main/Kconfig.projbuild
```kconfig
menu "WxPaper bridge"

config WXB_WIFI_SSID
	string "Wi-Fi SSID"
	default ""

config WXB_WIFI_PASSWORD
	string "Wi-Fi password"
	default ""

config WXB_HOST_URL
	string "wxd serve base URL"
	default "http://tiny:8787"
	help
	  Base URL of `wxd serve` on the host PC (no trailing slash).

config WXB_DEVICE_ADDR
	string "Pinned display BLE address (optional)"
	default ""
	help
	  e.g. EB:11:79:5D:39:62. Empty = any device advertising the WxPaper
	  service UUID or name.

config WXB_DEBOUNCE_S
	int "Ignore a display for this long after a successful session (s)"
	default 20

config WXB_HTTP_TIMEOUT_MS
	int "HTTP timeout (ms)"
	default 8000

endmenu
```

## bridge/sdkconfig.defaults
```kconfig
CONFIG_IDF_TARGET="esp32c6"
CONFIG_ESPTOOLPY_FLASHSIZE_4MB=y

# Bluetooth: NimBLE, central only
CONFIG_BT_ENABLED=y
CONFIG_BT_NIMBLE_ENABLED=y
CONFIG_BT_BLUEDROID_ENABLED=n
CONFIG_BT_NIMBLE_ROLE_CENTRAL=y
CONFIG_BT_NIMBLE_ROLE_OBSERVER=y
CONFIG_BT_NIMBLE_ROLE_PERIPHERAL=n
CONFIG_BT_NIMBLE_ROLE_BROADCASTER=n
CONFIG_BT_NIMBLE_MAX_CONNECTIONS=1
CONFIG_BT_NIMBLE_GATT_SERVER=n
CONFIG_BT_NIMBLE_SECURITY_ENABLE=n
CONFIG_BT_NIMBLE_ATT_PREFERRED_MTU=247
CONFIG_BT_NIMBLE_50_FEATURE_SUPPORT=n
CONFIG_BT_NIMBLE_ENABLE_CONN_REATTEMPT=n
# room for a burst of Write Without Response PDUs
CONFIG_BT_NIMBLE_MSYS_1_BLOCK_COUNT=24
CONFIG_BT_NIMBLE_MSYS_1_BLOCK_SIZE=320
CONFIG_BT_NIMBLE_TRANSPORT_ACL_FROM_LL_COUNT=24

# Wi-Fi + BLE share the radio
CONFIG_ESP_COEX_SW_COEXIST_ENABLE=y

CONFIG_ESP_TASK_WDT_EN=y
CONFIG_ESP_TASK_WDT_TIMEOUT_S=60
CONFIG_LOG_DEFAULT_LEVEL_INFO=y

# Wi-Fi + BLE + HTTP is ~1.3 MB: use the 1.5 MB single-app partition
CONFIG_PARTITION_TABLE_SINGLE_APP_LARGE=y
CONFIG_COMPILER_OPTIMIZATION_SIZE=y
```
